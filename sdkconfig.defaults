## sdkconfig.defaults
```kconfig
# Flash size
CONFIG_ESPTOOLPY_FLASHSIZE_16MB=y
CONFIG_ESPTOOLPY_FLASHSIZE="16MB"
CONFIG_PARTITION_TABLE_CUSTOM=y
CONFIG_PARTITION_TABLE_CUSTOM_FILENAME="partitions.csv"
CONFIG_PARTITION_TABLE_CUSTOM_FILENAME="partitions.csv"

# Chip revision
CONFIG_ESP32P4_SELECTS_REV_LESS_V3=y
CONFIG_ESP32P4_REV_MIN_1=y
CONFIG_ESP32P4_REV_MIN_FULL=1

# Memory and Speed
CONFIG_ESP_DEFAULT_CPU_FREQ_MHZ_360=y
CONFIG_COMPILER_OPTIMIZATION_PERF=y
CONFIG_SPIRAM=y
CONFIG_SPIRAM_MODE_HEX=y
CONFIG_SPIRAM_SPEED_200M=y
CONFIG_SPIRAM_BOOT_INIT=y
CONFIG_SPIRAM_MALLOC_ALWAYSINTERNAL=4096

# Watchdog
CONFIG_ESP_TASK_WDT_TIMEOUT_S=10

# Display
CONFIG_BSP_LCD_TYPE_1024_600=y

# Camera config
CONFIG_ESP_VIDEO_ENABLE_ISP_VIDEO_DEVICE=y
CONFIG_ESP_VIDEO_ENABLE_ISP_PIPELINE_CONTROLLER=n

# OV9281 Sensor - 640x400 50fps (Stable for P4 bus)
CONFIG_CAMERA_OV9281=y
CONFIG_CAMERA_OV9281_AUTO_DETECT=y
CONFIG_CAMERA_OV9281_AUTO_DETECT_MIPI_INTERFACE_SENSOR=y
CONFIG_CAMERA_OV9281_SID_LOW=y
CONFIG_CAMERA_OV9281_MIPI_RAW8_640X400_50FPS=y
CONFIG_CAMERA_OV9281_MIPI_IF_FORMAT_INDEX_DEFAULT=1

# Disable other sensors
CONFIG_CAMERA_OV5647=n
CONFIG_CAMERA_SC2336=n
```
